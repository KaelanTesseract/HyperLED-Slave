/*
 * HyperLED - Open Source LED Controller
 *
 * Copyright (c) 2026 Dennis Guse
 *
 * Licensed under the EUPL, Version 1.2 or – as soon they will be approved by
 * the European Commission - subsequent versions of the EUPL (the "Licence");
 * You may not use this work except in compliance with the Licence.
 * You may obtain a copy of the Licence at:
 *
 * https://joinup.ec.europa.eu/software/page/eupl
 *
 * Unless required by applicable law or agreed to in writing, software
 * distributed under the Licence is distributed on an "AS IS" basis,
 * WITHOUT WARRANTIES OR CONDITIONS OF ANY KIND, either express or implied.
 * See the Licence for the specific language governing permissions and
 * limitations under the Licence.
 */
#pragma once

#include <Arduino.h>

// Compact 3x5 "mini" bitmap font - same character coverage as Font5x7.h, but
// small enough to fit more text/elements on a matrix. At 3 columns wide,
// M/N/U/V/W are necessarily simplified/approximated - still distinguishable
// in context, but not as crisp as the 5x7 font. Each glyph is 5 rows of 3
// bits (bit 2 = leftmost column, bit 0 = rightmost column).
static const uint8_t FONT3X5[][5] = {
    {0x0,0x0,0x0,0x0,0x0}, // ' '
    {0x7,0x5,0x5,0x5,0x7}, // '0'
    {0x2,0x6,0x2,0x2,0x7}, // '1'
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    {0x2,0x5,0x2,0x0,0x0}, // '`' (used as the degree sign, e.g. "18`C")
};
#define FONT3X5_GLYPH_WIDTH 3
#define FONT3X5_GLYPH_HEIGHT 5

// Maps an ASCII character to its glyph index in FONT3X5, or -1 if unsupported
// (unsupported characters render as a blank space-width gap). Same layout as
// font5x7_glyphIndex() in Font5x7.h.
inline int8_t font3x5_glyphIndex(char c) {
    if (c == ' ') return 0;
    if (c >= '0' && c <= '9') return 1 + (c - '0');
    if (c >= 'a' && c <= 'z') c -= 32; // fold lowercase to the uppercase glyphs
    if (c >= 'A' && c <= 'Z') return 11 + (c - 'A');
    switch (c) {
        case ':': return 37;
        case '.': return 38;
        case ',': return 39;
        case '-': return 40;
        case '/': return 41;
        case '!': return 42;
        case '?': return 43;
        case '`': return 44; // degree sign stand-in - see FONT3X5 above
        default: return -1;
    }
}

// Returns true if the pixel at (col, row) of character c is lit. col/row are
// 0-based, col 0 = leftmost, row 0 = topmost. Out-of-range or unsupported
// characters return false (render as blank).
inline bool font3x5_pixel(char c, uint8_t col, uint8_t row) {
    if (row >= FONT3X5_GLYPH_HEIGHT || col >= FONT3X5_GLYPH_WIDTH) return false;
    int8_t idx = font3x5_glyphIndex(c);
    if (idx < 0) return false;
    return (FONT3X5[idx][row] >> (FONT3X5_GLYPH_WIDTH - 1 - col)) & 1;
}
