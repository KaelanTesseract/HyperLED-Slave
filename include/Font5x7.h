/*
 * HyperLED - Open Source LED Controller
 *
 * Copyright (c) 2026 Dennis Guse
 *
 * Licensed under the EUPL, Version 1.2 or – as soon they will be approved by
 * the European Commission - subsequent versions of the EUPL (the "Licence");
 * You may not use this work except in compliance with the Licence.
 * You may obtain a copy of the Licence at:
 *
 * https://joinup.ec.europa.eu/software/page/eupl
 *
 * Unless required by applicable law or agreed to in writing, software
 * distributed under the Licence is distributed on an "AS IS" basis,
 * WITHOUT WARRANTIES OR CONDITIONS OF ANY KIND, either express or implied.
 * See the Licence for the specific language governing permissions and
 * limitations under the Licence.
 */
#pragma once

#include <Arduino.h>

// Minimal 5x7 bitmap font covering space, digits, uppercase A-Z and a handful
// of punctuation marks - just enough for a clock/date/short-text display on a
// matrix panel. Each glyph is 7 rows of 5 bits (bit 4 = leftmost column, bit 0
// = rightmost column), hand-drawn - no external font library/data is linked
// in, keeping the flash footprint minimal.
static const uint8_t FONT5X7[][7] = {
    {0x00,0x00,0x00,0x00,0x00,0x00,0x00}, // ' '
    {0x0E,0x11,0x13,0x15,0x19,0x11,0x0E}, // '0'
    {0x04,0x0C,0x04,0x04,0x04,0x04,0x0E}, // '1'
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    {0x0C,0x12,0x0C,0x00,0x00,0x00,0x00}, // '`' (used as the degree sign, e.g. "18`C")
};
#define FONT5X7_GLYPH_WIDTH 5
#define FONT5X7_GLYPH_HEIGHT 7

// Maps an ASCII character to its glyph index in FONT5X7, or -1 if unsupported
// (unsupported characters render as a blank space-width gap).
inline int8_t font5x7_glyphIndex(char c) {
    if (c == ' ') return 0;
    if (c >= '0' && c <= '9') return 1 + (c - '0');
    if (c >= 'a' && c <= 'z') c -= 32; // fold lowercase to the uppercase glyphs
    if (c >= 'A' && c <= 'Z') return 11 + (c - 'A');
    switch (c) {
        case ':': return 37;
        case '.': return 38;
        case ',': return 39;
        case '-': return 40;
        case '/': return 41;
        case '!': return 42;
        case '?': return 43;
        case '`': return 44; // degree sign stand-in - see FONT5X7 above
        default: return -1;
    }
}

// Returns true if the pixel at (col, row) of character c is lit. col/row are
// 0-based, col 0 = leftmost, row 0 = topmost. Out-of-range or unsupported
// characters return false (render as blank).
inline bool font5x7_pixel(char c, uint8_t col, uint8_t row) {
    if (row >= FONT5X7_GLYPH_HEIGHT || col >= FONT5X7_GLYPH_WIDTH) return false;
    int8_t idx = font5x7_glyphIndex(c);
    if (idx < 0) return false;
    return (FONT5X7[idx][row] >> (FONT5X7_GLYPH_WIDTH - 1 - col)) & 1;
}
